## village-kernel/vendor/arm/cortex-m/hal/st/stm32h7xx/Kconfig
```kconfig
config HAL_GPIO
	bool "Enable GPIO HAL class"
	default y

config HAL_GPI
	depends on HAL_GPIO
	bool "Enable GPI HAL class"
	default y

config HAL_GPO
	depends on HAL_GPIO
	bool "Enable GPO HAL class"
	default y

config HAL_NVIC
	bool "Enalbe NVIC HAL class"
	default y

config HAL_USART
	select HAL_GPIO
	bool "Enable USART HAL clas"
	default n

config HAL_SPI
	select HAL_GPIO
	bool "Enable SPI HAL class"
	default n

config HAL_I2C
	select HAL_GPIO
	bool "Enable I2C HAL class"
	default n

config HAL_DMA
	bool "Enable dma HAL class"
	default n

config HAL_FSMC
	select HAL_GPIO
	bool "Enable FSMC HAL class"
	default n
```

## village-kernel/vendor/x86/bios/Kconfig
```kconfig
comment "Configure Support Function"

# config cpu menu
menu "CPU Support Package"

comment "This is using to configure x86 arch"

config BOOTSECTION
	bool "The arch has boot setion"
	default y

endmenu

# config hal menu
menu "Hardware Abstraction Layer"

config HAL_PCI_CONTROLLER
	bool "Enable pci controller class"
	default y

config HAL_PS2_CONTROLLER
	bool "Enable ps2 controller class"
	default y

endmenu

# Config driver menu
menu "Generic Device Driver"

config ATALBADISK
	tristate "Enable ATA LBA disk support"
	default n

config BOCHSVBE
	select HAL_PCI_CONTROLLER
	tristate "Enable Bochs VBE support"
	default n

config GENERALTIMER
	tristate "Enable general timer support"
	default n

config PS2KEYBOARD
	tristate "Enable ps2 key board input support"
	default n

config PS2MOUSE
	select HAL_PS2_CONTROLLER
	tristate "Enable ps2 mouse input support"
	default n

config SERIALPORT
	tristate "Enable serial port support"
	default y
	
endmenu
```

## village-kernel/vendor/x86/bios/hal/Kconfig
```kconfig
menu "Hardware Abstraction Layer"

config HAL_PCI_CONTROLLER
	bool "Enable pci controller class"
	default y

config HAL_PS2_CONTROLLER
	bool "Enable ps2 controller class"
	default y

endmenu
```

## village-kernel/vklibs/libhw/ia32/legacy/Kconfig
```kconfig
comment "Configure Support Function"

# config drv menu
menu "Hardware Abstraction Layer"

config DRV_PCI_CONTROLLER
	bool "Enable pci controller class"
	default y

config DRV_PS2_CONTROLLER
	bool "Enable ps2 controller class"
	default y

endmenu
```

## village-machine/Kconfig
```kconfig
comment "This is using to configure machine"

config MACHINE
	bool "Enable building machine"
	default y

if MACHINE
	# config arch

	menu "arch"

	comment "Select CPU Architecture"

	choice
		prompt "Architecture"
		default ARM

		config ARM
			bool "arm"

		config IA32
			bool "ia32"
	endchoice

	choice
		prompt "ARM Series"
		depends on ARM
		default CORTEX_M

		config CORTEX_A
			bool "cortex-A"

		config CORTEX_R
			bool "cortex-R"

		config CORTEX_M
			bool "cortex-M"
	endchoice

	choice
		prompt "MCU Manufacturer"
		depends on CORTEX_M
		default ST

		config ST
			bool "ST"
	endchoice

	choice
		prompt "MCU Series"
		depends on ST
		default STM32F4xx

		config STM32F4xx
			bool "STM32F4xx"

		config STM32H7xx
			bool "STM32H7xx"
	endchoice

	choice
		prompt "MCU Type"
		depends on STM32F4xx
		default STM32F407xx

		config STM32F401xc
			bool "STM32F401xc"

		config STM32F401xe
			bool "STM32F401xe"

		config STM32F405xx
			bool "STM32F405xx"

		config STM32F407xx
			bool "STM32F407xx"
	endchoice

	choice
		prompt "MCU Model"
		depends on STM32F407xx
		default STM32F407ZE

		config STM32F407IE
			bool "STM32F407IE"

		config STM32F407IG
			bool "STM32F407IG"

		config STM32F407VE
			bool "STM32F407VE"

		config STM32F407VG
			bool "STM32F407VG"

		config STM32F407ZE
			bool "STM32F407ZE"

		config STM32F407ZG
			bool "STM32F407ZG"
	endchoice

	choice
		prompt "MCU Model"
		depends on STM32F405xx
		default STM32F405RG

		config STM32F405OE
			bool "STM32F405OE"

		config STM32F405OG
			bool "STM32F405OG"

		config STM32F405RG
			bool "STM32F405RG"

		config STM32F405VG
			bool "STM32F405VG"

		config STM32F405ZG
			bool "STM32F405ZG"
	endchoice

	choice
		prompt "MCU Type"
		depends on STM32H7xx
		default STM32H743xx

		config STM32H743xx
			bool "STM32H743xx"

		config STM32H750xx
			bool "STM32H750xx"
	endchoice

	choice
		prompt "MCU Model"
		depends on STM32H743xx
		default STM32H743II

		config STM32H743VI
			bool "STM32H743VI"

		config STM32H743ZI
			bool "STM32H743ZI"

		config STM32H743AI
			bool "STM32H743AI"

		config STM32H743II
			bool "STM32H743II"

		config STM32H743BI
			bool "STM32H743BI"

		config STM32H743XI
			bool "STM32H743XI"

		config STM32H743VG
			bool "STM32H743VG"

		config STM32H743ZG
			bool "STM32H743ZG"

		config STM32H743AG
			bool "STM32H743AG"

		config STM32H743IG
			bool "STM32H743IG"

		config STM32H743BG
			bool "STM32H743BG"

		config STM32H743XG
			bool "STM32H743XG"
	endchoice

	choice
		prompt "MCU Model"
		depends on STM32H750xx
		default STM32H750IB

		config STM32H750IB
			bool "STM32H750IB"

		config STM32H750VB
			bool "STM32H750VB"

		config STM32H750XB
			bool "STM32H750XB"

		config STM32H750ZB
			bool "STM32H750ZB"
	endchoice

	choice
		prompt "Boot Mode"
		depends on IA32
		default IA32LEGACY

		config IA32LEGACY
			bool "legacy"

		config IA32UEFI
			bool "uefi"
	endchoice

	endmenu

	menu "board"

	if IA32LEGACY
		choice
			prompt "board"
			default IA32LEGACY_BOARD

			config IA32LEGACY_BOARD
				bool "ia32legacy board"
		endchoice
	endif

	if STM32F4xx
		choice
			prompt "board"
			default STM32F407_BOARD

			config STM32F407_BOARD
				bool "stm32f407 board"
		endchoice
	endif

	if STM32H7xx
		choice
			prompt "board"
			default STM32H743_BOARD

			config STM32H743_BOARD
				bool "stm32h743 board"
		endchoice
	endif

 	endmenu
	
	menu "chipdrv"

	# IA32Legacy chip drv

	if IA32LEGACY

	config IA32LEGACY_DRV_PCI
		bool "Enable pci controller class"
		default y

	config IA32LEGACY_DRV_PS2
		bool "Enable ps2 controller class"
		default y

	endif

	# STM32F4xx chip drv

	if STM32F4xx

	config STM32F4XX_DRV_HAL
		bool "Enable Hal drv class"
		default n

	config STM32F4XX_DRV_GPIO
		bool "Enable GPIO drv class"
		default y

	config STM32F4XX_DRV_NVIC
		bool "Enalbe NVIC drv class"
		default y

	config STM32F4XX_DRV_USART
		select STM32F4XX_DRV_GPIO
		bool "Enable USART drv clas"
		default n

	config STM32F4XX_DRV_SPI
		select STM32F4XX_DRV_GPIO
		bool "Enable SPI drv class"
		default n

	config STM32F4XX_DRV_I2C
		select STM32F4XX_DRV_GPIO
		bool "Enable I2C drv class"
		default n

	config STM32F4XX_DRV_DMA
		bool "Enable dma drv class"
		default n

	config STM32F4XX_DRV_LCD_8080
		bool "Enable lcd 8080 interface drv class"
		default n

	config STM32F4XX_DRV_EXTI
		select STM32F4XX_DRV_GPIO
		select STM32F4XX_DRV_NVIC
		bool "Enable EXTI drv class"
		default n

	config STM32F4XX_DRV_USB
		select STM32F4XX_DRV_GPIO
		select STM32F4XX_DRV_NVIC
		bool "Enable USB drv class"
		default n

	endif

	# STM32H7xx chip drv

	if STM32H7xx

	config STM32H7XX_DRV_HAL
		bool "Enable Hal drv class"
		default n

	config STM32H7XX_DRV_GPIO
		bool "Enable GPIO drv class"
		default y

	config STM32H7XX_DRV_LTDC
		select STM32H7XX_DRV_GPIO
		bool "Enalbe LTDC drv class"
		default y

	config STM32H7XX_DRV_NVIC
		bool "Enalbe NVIC drv class"
		default y

	config STM32H7XX_DRV_USART
		select STM32H7XX_DRV_GPIO
		bool "Enable USART drv clas"
		default n

	config STM32H7XX_DRV_SDIO
		select STM32H7XX_DRV_GPIO
		bool "Enable SDIO drv class"
		default n

	config STM32H7XX_DRV_SPI
		select STM32H7XX_DRV_GPIO
		bool "Enable SPI drv class"
		default n

	config STM32H7XX_DRV_I2C
		select STM32H7XX_DRV_GPIO
		bool "Enable I2C drv class"
		default n

	config STM32H7XX_DRV_DMA
		bool "Enable DMA drv class"
		default n

	config STM32H7XX_DRV_DMA2D
		bool "Enable DMA2D drv class"
		default n

	config STM32H7XX_DRV_SDRAM
		select STM32H7XX_DRV_GPIO
		bool "Enable sdram drv class"
		default n

	endif

	endmenu

	menu "platdrv"

	menu "block"

	config ATALBADISK
		tristate "Enable ata lba disk support"
		default n

	config SDIOSDCARD
		tristate "Enable sdio sd card support"
		default n

	config SPISDCARD
		tristate "Enable spi sd card support"
		default n

	config SPIW25QXX
		tristate "Enable spi w25qxx flash support"
		default n

	endmenu

	menu "display"

	config BOCHS_VBE
		tristate "Enable Bochs VBE support"
		default n

	config LCD_ILI9488
		tristate "Enable ILI9488 support"
		default n

	config LCD_LTDC
		tristate "Enable LTDC LCD support"
		default n

	endmenu

	menu "dma"

	config STM32DMA
		tristate "Enable stm32 dma fifo support"
		default n

	endmenu

	menu "keyboard"

	config PS2KEYBOARD
		tristate "Enable ps2 key board input support"
		default n

	endmenu

	menu "mouse"

	config PS2MOUSE
		tristate "Enable ps2 mouse input support"
		default n

	endmenu

	menu "sdram"

	config SDRAM_W9825G6
		tristate "Enable w9825g6 sdram support"
		default n

	endmenu

	menu "serial"

	config PIC32UART
		tristate "Enable pic32 uart support"
		default n

	config STM32UART
		tristate "Enable stm32 uart support"
		default n

	endmenu

	menu "timer"

	config PIT32TIMER
		tristate "Enable pit32 timer support"
		default n

	endmenu

	menu "usb"

	config STM32USB
		tristate "Enable stm32 usb support"
		default n

	endmenu

	endmenu

	menu "vendor"
		if IA32LEGACY
			source ./village-machine/vendor/ia32legacy/Kconfig
		endif
		if STM32F4xx
			source ./village-machine/vendor/stm32f4xx/Kconfig
		endif
		if STM32H7xx
			source ./village-machine/vendor/stm32h7xx/Kconfig
		endif
	endmenu

endif
```

## village-os/Kconfig
```kconfig
comment "This is using to configure vkos"

config VKOS
	bool "Enable building vkos"
	default y

if VKOS

	menu "libraries"
		comment "This is using to configure libraries"
	endmenu

	menu "programs"
		comment "This is using to configure programs"
		source ./village-os/programs/desktop/Kconfig
		source ./village-os/programs/filemgr/Kconfig
		source ./village-os/programs/monitor/Kconfig
		source ./village-os/programs/settings/Kconfig
		source ./village-os/programs/terminal/Kconfig
	endmenu

	menu "services"
		comment "This is using to configure service"
		source ./village-os/services/taichi/Kconfig
		source ./village-os/services/input/Kconfig
		source ./village-os/services/vkgui/Kconfig
	endmenu

endif
```

## village-os/applications/Kconfig
```kconfig
comment "This is using to configure application"

if GENERATED_APP

source ./village-os/applications/taichi/Kconfig

source ./village-os/applications/desktop/Kconfig

source ./village-os/applications/settings/Kconfig

source ./village-os/applications/simpleInput/Kconfig

endif
```

## village-os/applications/desktop/Kconfig
```kconfig
# desktop menu

menu "desktop"

config DESKTOP_APP
	bool "Build desktop application"
	default y

endmenu
```

## village-os/applications/input/Kconfig
```kconfig
# keyboinputard menu

menu "input"

config INPUT
	bool "Build input application"
	default y

endmenu
```

## village-os/applications/launch/Kconfig
```kconfig
# launch menu

menu "launch"

config LAUNCH
	bool "Build launch application"
	default y

if LAUNCH

endif

endmenu
```

## village-os/applications/settings/Kconfig
```kconfig
# settings menu

menu "settings"

config SETTINGS_APP
	bool "Build settings application"
	default y

if SETTINGS_APP

config SETTINGS_POWER_UP
	bool "Running when power up"
	default n

endif

endmenu
```

## village-os/applications/simpleInput/Kconfig
```kconfig
# keyboinputard menu

menu "simple input"

config SIMPLE_INPUT_APP
	bool "Build simple input method application"
	default y

endmenu
```

## village-os/applications/taichi/Kconfig
```kconfig
# taichi menu

menu "taichi"

config TAICHI
	bool "Build taichi application"
	default y

if TAICHI

endif

endmenu
```

## village-os/applications/terminal/Kconfig
```kconfig
# terminal menu

menu "terminal"

config TERMINAL_APP
	bool "Build terminal application"
	default y

if TERMINAL_APP

endif

endmenu
```

## village-os/libraries/vkgui/Kconfig
```kconfig
# config GUI

config VKGUI
	bool "Enable village GUI support"
	default n

# config wedget

menu "Wedget"
	depends on VKGUI

config VKGUI_BUTTON
	bool "Enable button support"
	default y

config VKGUI_CURSOR
	bool "Enable cursor support"
	default y

config VKGUI_FRAME
	bool "Enable frame support"
	default y

config VKGUI_LABEL
	bool "Enable label support"
	default y

config VKGUI_LISTBOX
	bool "Enable list box support"
	default y

config VKGUI_MENU
	bool "Enable menu support"
	default y

config VKGUI_MSGBOX
	bool "Enable message box support"
	default y

config VKGUI_TABBAR
	bool "Enable tab bar support"
	default y

config VKGUI_TEXTBOX
	bool "Enable text box support"
	default y

config VKGUI_TOOLBAR
	bool "Enable tool bar support"
	default y

config VKGUI_WINDOW
	bool "Enable window support"
	default y

endmenu
```

## village-os/programs/desktop/Kconfig
```kconfig
# desktop menu

menu "desktop"

config DESKTOP_APP
	bool "Build desktop application"
	default y

if DESKTOP_APP

config DESKTOP_POWER_UP
	bool "Running when power up"
	default n

endif

endmenu
```

## village-os/programs/filemgr/Kconfig
```kconfig
# filemgr menu

menu "filemgr"

config FILEMGR_APP
	bool "Build file manager application"
	default y

if FILEMGR_APP

config FILEMGR_POWER_UP
	bool "Running when power up"
	default n

endif

endmenu
```

## village-os/programs/manager/Kconfig
```kconfig
# manager menu

menu "manager"

config MANAGER_APP
	bool "Build manager application"
	default y

if MANAGER_APP

config MANAGER_POWER_UP
	bool "Running when power up"
	default n

endif

endmenu
```

## village-os/programs/monitor/Kconfig
```kconfig
# monitor menu

menu "monitor"

config MONITOR_APP
	bool "Build monitor application"
	default y

if MONITOR_APP

config MONITOR_POWER_UP
	bool "Running when power up"
	default n

endif

endmenu
```

## village-os/programs/terminal/Kconfig
```kconfig
# terminal menu

menu "terminal"

config TERMINAL_APP
	bool "Build terminal application"
	default y

if TERMINAL_APP

config TERMINAL_POWER_UP
	bool "Running when power up"
	default n

endif

endmenu
```

## village-os/services/gui/Kconfig
```kconfig
# gui menu

menu "gui"

config GUI_SERVICE
	bool "Build GUI service"
	default y

endmenu
```

## village-os/services/input/Kconfig
```kconfig
# input menu

menu "input"

config INPUT_SERVICE
	bool "Build input method service"
	default y

if INPUT_SERVICE

config INPUT_POWER_UP
	bool "Running when power up"
	default n

endif

endmenu
```
