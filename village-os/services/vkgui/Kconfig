## village-os/services/vkgui/Kconfig
```kconfig
# gui menu

menu "vkgui"

config VKGUI_SERVICE
	bool "Build village GUI service"
	default y

if VKGUI_SERVICE

config VKGUI_POWER_UP
	bool "Running when power up"
	default n

endif

endmenu
```

## vk.application/Kconfig
```kconfig
comment "This is using to configure application"

# application
config APPLICATION1
	tristate "Add application1 to project"
	default y

config APPLICATION2
	tristate "Add application2 to project"
	default y

config APPLICATION3
	depends on GUI
	tristate "Add application3 to project"
	default n

config APPLICATION4
	tristate "Add application4 to project"
	default m

config APPLICATION5
	tristate "Add application5 to project"
	default m
```

## vk.bootloader/Kconfig
```kconfig
# bootloader
config BOOTLOADER
	bool "Enable bootloader function"
	default n

if BOOTLOADER

comment "Select bootloader"

choice
	prompt "bootloader"
	default X86BIOS

	config X86BIOS
		bool "x86 bios boot"

	config X64UEFI
		bool "x64 uefi boot"
endchoice

if X86BIOS
	source ./vk.bootloader/x86bios/Kconfig
endif

if X64UEFI
	source ./vk.bootloader/x64uefi/Kconfig
endif

endif
```

## vk.gui/Kconfig
```kconfig
comment "This is using to configure GUI"

# config GUI

config GUI
	bool "Enable GUI support"
	default n

# config wedget

menu "Wedget"
	depends on GUI 

config GUI_BUTTON
	bool "Enable button support"
	default y

config GUI_CURSOR
	bool "Enable cursor support"
	default y

config GUI_FRAME
	bool "Enable frame support"
	default y

config GUI_LABEL
	bool "Enable label support"
	default y

config GUI_LISTBOX
	bool "Enable list box support"
	default y

config GUI_MENU
	bool "Enable menu support"
	default y

config GUI_MSGBOX
	bool "Enable message box support"
	default y

config GUI_TABBAR
	bool "Enable tab bar support"
	default y

config GUI_TEXTBOX
	bool "Enable text box support"
	default y

config GUI_TOOLBAR
	bool "Enable tool bar support"
	default y

config GUI_WINDOW
	bool "Enable window support"
	default y

endmenu
```

## vk.hardware/Kconfig
```kconfig
comment "Select CPU Architecture"

choice
	prompt "Architecture"
	default ARM

	config ARM
		bool "arm"

	config X86
		bool "x86"
		select BOOTSECTION
endchoice

comment "Configure Support Function"

## ARM
if ARM

choice
	prompt "ARM Series"
	depends on ARM
	default CORTEX_M

	config CORTEX_A
		bool "cortex-A"

	config CORTEX_R
		bool "cortex-R"

	config CORTEX_M
		bool "cortex-M"
endchoice

if CORTEX_M
	source ./vk.hardware/arm/cortex-m/Kconfig
endif

endif

## X86
if X86

choice
	prompt "Boot fireware"
	depends on X86
	default BIOS

	config BIOS
		bool "bios"

endchoice

if BIOS
	source ./vk.hardware/x86/bios/Kconfig
endif

endif
```

## vk.hardware/arm/cortex-m/hal/st/Kconfig
```kconfig
menu "Hardware Abstraction Layer"

if STM32F4xx
	source ./vk.hardware/arm/cortex-m/hal/st/stm32f4xx/Kconfig
endif

if STM32H7xx
	source ./vk.hardware/arm/cortex-m/hal/st/stm32h7xx/Kconfig
endif

endmenu
```

## vk.hardware/x86/Kconfig
```kconfig
comment "Configure Support Function"

choice
	prompt "Boot fireware"
	depends on X86
	default BIOS

	config BIOS
		bool "bios"

endchoice

if BIOS
	source ./vk.hardware/x86/bios/Kconfig
endif
```

## vk.hardware/x86/bios/Kconfig
```kconfig
comment "Configure Support Function"

source ./vk.hardware/x86/bios/cpu/Kconfig
source ./vk.hardware/x86/bios/hal/Kconfig
source ./vk.hardware/x86/bios/driver/Kconfig
```

## vk.hardware/x86/bios/driver/Kconfig
```kconfig
# Config driver menu
menu "Generic Device Driver"

config ATALBADISK
	tristate "Enable ATA LBA disk support"
	default n

config BOCHSVBE
	select HAL_PCI_CONTROLLER
	tristate "Enable Bochs VBE support"
	default n

config PS2KEYBOARD
	tristate "Enable ps2 key board input support"
	default n

config PS2MOUSE
	select HAL_PS2_CONTROLLER
	tristate "Enable ps2 mouse input support"
	default n

config SERIALPORT
	tristate "Enable serial port support"
	default y
	
endmenu
```

## vk.kernel/Kconfig
```kconfig
comment "This is using to configure kernel"

config KERNEL
	bool "Enable building kernel"
	default y

if KERNEL

# config kernel menu

menu "kernel"

config TASK_STACK
	int "The size of thread task stack"
	default 1024

config MODULE
	bool "Enable loadable module support"
	select FATFS
	select ELFPARSER
	select ENVIRONMENT

config ENVIRONMENT
	depends on MODULE
	bool "Build the environment of Loadable module"
	default y

endmenu

#config bridge

menu "bridge"

config BRIDGE
	bool "Enable the bridge from kernel to user"
	default n

config VILLAGE
	depends on BRIDGE
	bool "Enable k2u the village kernel api"
	default n

endmenu

# confg binutils menu

menu "binutils"

config BINUTILS
	select FILESTREAM
	bool "Enable binutils function"
	default n

config BINLOADER
	depends on BINUTILS
	select FILESTREAM
	bool "Enable *.bin file load function"
	default n

config BINEXECUTOR
	depends on BINUTILS
	select BINLOADER
	bool "Enable execute *.bin file function"
	default n

config ELFLOADER
	depends on BINUTILS
	select FILESTREAM
	bool "Enable *.elf file load function"
	default n

config ELFEXECUTOR
	depends on BINUTILS
	select ELFLOADER
	bool "Enable execute *.elf file function"
	default n

config LIBTOOL
	depends on BINUTILS
	bool "Enable library tool function"
	default n

config MODTOOL
	depends on BINUTILS
	bool "Enable module tool function"
	default n

endmenu

#config subsystem

menu "subsystem"

config SUBSYS
	depends on MODULE
	bool "Enable sub system support"
	default n

config LOADER
	depends on SUBSYS
	bool "Enable loader support"
	default y

config INPUT
	depends on SUBSYS
	bool "Enable input support"
	default y

config WORKQUEUE
	depends on SUBSYS
	bool "Enable workqueue support"
	default y

endmenu

# config utilities menu

menu "utilities"

config UTILITIES
	bool "Enable utilities support"
	default n

config SYNCLOCK
	depends on UTILITIES
	bool "Enable sync lock function"
	 default y

config INIPARSER
	depends on UTILITIES
	select FILESTREAM
	bool "Enable ini file parser function"
	default n

config PINPARSER
	depends on UTILITIES
	select FATFS
	bool "Enable pin parser function"
	default n

config RCPARSER
	depends on UTILITIES
	select FILESTREAM
	bool "Enable resource script parser function"
	default n

config REGEX
	depends on UTILITIES
	bool "Enable regex function"
	default n

endmenu

# config file system

menu "filesystem"

config FILESYSTEM
	bool "Enable file system"
	default n

config FATFS
	depends on FILESYSTEM
	bool "Add fat file system in support list"
	default n

endmenu

# cofing synchronizes menu

menu "synchronizes"

config SYNC
	bool "Enable synchronizes function"
	default y

config MUTEX
	depends on SYNC
	bool "Enable mutex lock support"
	default y

config SPINLOCK
	depends on SYNC
	bool "Enable spin lock support"
	default y

config SEMAPHORE
	depends on SYNC
	bool "Enable semaphore support"
	default y

endmenu

endif
```

## vk.library/Kconfig
```kconfig
# config libraries menu

config VKLIBC
	bool "Using village kernel libc as c library"
	default y
```

## x86/Kconfig
```kconfig
comment "Configure Support Function"

choice
	prompt "Boot fireware"
	depends on X86
	default BIOS

	config BIOS
		bool "bios"

	config UEFI
		bool "uefi"

endchoice

if BIOS
	source ./vk.hardware/x86/bios/Kconfig
endif

if UEFI
	source ./vk.hardware/x86/uefi/Kconfig
endif
```

## x86/driver/Kconfig
```kconfig
# Config driver menu
menu "Generic Device Driver"

config SERIAL
	tristate "Enable serial support"
	default n

config VGA
	tristate "Enable VGA support"
	default n

config DISK
	tristate "Enable LBA disk support"
	default n
	
endmenu
```
