## BSP/Kconfig
```kconfig
choice
	prompt "Architecture"
	default ARM

	config ARM
		bool "arm"

	config X86
		bool "x86"
		select BOOTSECTION
endchoice

choice
	prompt "ARM architecutre"
	depends on ARM
	default CORTEX_M

	config CORTEX_A
		bool "cortex-A"

	config CORTEX_R
		bool "cortex-R"

	config CORTEX_M
		bool "cortex-M"
endchoice

choice
	prompt "Manufacturer"
	depends on CORTEX_M
	default ST

	config ST
		bool "ST"

	config GD
		bool "GD"
endchoice

if ST
	source ./vk.hardware/BSP/ST/Kconfig
endif

if X86
	source ./vk.hardware/BSP/x86/Kconfig
endif
```

## BSP/ST/Kconfig
```kconfig
choice
	prompt "MCU Series"
	depends on ST
	default STM32F4xx

	config STM32F4xx
		bool "STM32F4xx"

	config STM32H7xx
		bool "STM32H7xx"
endchoice

# config stm32f4xx
if STM32F4xx

choice
	prompt "MCU Type"
	depends on STM32F4xx
	default STM32F407xx

	config STM32F401xc
		bool "STM32F401xc"

	config STM32F401xe
		bool "STM32F401xe"

	config STM32F405xx
		bool "STM32F405xx"

	config STM32F407xx
		bool "STM32F407xx"

endchoice


choice
	prompt "MCU Model"
	depends on STM32F407xx
	default STM32F407ZE

	config STM32F407IE
		bool "STM32F407IE"

	config STM32F407IG
		bool "STM32F407IG"

	config STM32F407VE
		bool "STM32F407VE"

	config STM32F407VG
		bool "STM32F407VG"

	config STM32F407ZE
		bool "STM32F407ZE"

	config STM32F407ZG
		bool "STM32F407ZG"
endchoice

endif

# config stm32h7xx
if STM32H7xx

choice
	prompt "MCU Type"
	depends on STM32H7xx
	default STM32H750xx

	config STM32H750xx
		bool "STM32H750xx"

endchoice

choice
	prompt "MCU Model"
	depends on STM32H750xx
	default STM32H750IB

	config STM32H750IB
		bool "STM32H750IB"

	config STM32H750VB
		bool "STM32H750VB"

	config STM32H750XB
		bool "STM32H750XB"

	config STM32H750ZB
		bool "STM32H750ZB"
endchoice

endif


# Config manufacturer hal driver
config MANUFACTURER_HAL_DRIVER
	bool "Use the HAL driver provided by the manufacturer"

menu "STM32F4xx_HAL_driver"
	depends on MANUFACTURER_HAL_DRIVER && STM32F4xx
	source ./vk.hardware/BSP/ST/STM32F4xx_HAL_driver/Kconfig
endmenu

menu "STM32H7xx_HAL_driver"
	depends on MANUFACTURER_HAL_DRIVER && STM32H7xx
	source ./vk.hardware/BSP/ST/STM32F4xx_HAL_driver/Kconfig
endmenu
```

## BSP/x86/Kconfig
```kconfig
comment "This is using to configure x86 arch"

# bootsection
config BOOTSECTION
	bool "The arch has boot setion"
	default y
```

## DEV/Kconfig
```kconfig
if CORTEX_M
	source ./vk.hardware/DEV/arm/cortex-m/Kconfig
endif

if X86
	source ./vk.hardware/DEV/x86/Kconfig
endif
```

## DEV/x86/Kconfig
```kconfig
config UARTSERIAL
	select HAL_USART
	bool "Enable UART serial support"
	default n

config VGA
	bool "Enable VGA support"
	default n
	
```

## HAL/Kconfig
```kconfig
if STM32F4xx
	source ./vk.hardware/HAL/ST/STM32F4xx/Kconfig
endif

if STM32H7xx
	source ./vk.hardware/HAL/ST/STM32H7xx/Kconfig
endif
```

## HAL/x86/Kconfig
```kconfig
config HAL_SYSTEM
	bool "Enable SYSTEM HAL class"
	default y

config HAL_GPIO
	bool "Enable GPIO HAL class"
	default y

config HAL_GPI
	depends on HAL_GPIO
	bool "Enable GPI HAL class"
	default y

config HAL_GPO
	depends on HAL_GPIO
	bool "Enable GPO HAL class"
	default y

config HAL_USART
	bool "Enable USART HAL clas"
```

## Kconfig
```kconfig
mainmenu "Main Menu"

comment "This is village configure menu"

menu "Compiler"
comment "This is using to setting compiler tool"

config HOST_COMPILE_PREFIX
	string "host compile prefix"
	default ""

config HOST_COMPILE_SUFFIX
	string "host compile suffix"
	default ""

config CROSS_COMPILE_PREFIX
	string "cross compile prefix"
	default "i686-elf-"

config CROSS_COMPILE_SUFFIX
	string "cross compile suffix"
	default ""

config OPT
	string "optimization level"
	default "-O0"

config DEBUG
	bool "debug mode"
	default y

config VERBOSE_MODE
	bool "verbose mode"
	default n

config GENERATED_LIB
	bool "generated libs"
	default y

config POWER_UP_LOAD_LIBS
	depends on GENERATED_LIB
	bool "load library on power up"
	default y

config GENERATED_MOD
	bool "generated mods"
	option modules
	select MODULE
	default n

config GENERATED_VKOS
	bool "generated vkos"
	default y

config GENERATED_STATIC_PROG
	depends on GENERATED_VKOS
	bool "build with static"
	default n

config CREATE_PROG_HEX_FILE
	depends on GENERATED_STATIC_PROG
	bool "create *.hex file"
	default n

config CREATE_PROG_BIN_FILE
	depends on GENERATED_STATIC_PROG
	bool "create *.bin file"
	default n

config ASSOCIATED_EXEC
	depends on GENERATED_VKOS
	string "Associated with .exec"
	default ".elf"

config GENERATED_IMG
	bool "generated os image"
	default n

config ROOTFS
	string "rootfs path"
	default "/Volumes/SD"

endmenu

menu "village-boot"
	source ./village-boot/Kconfig
endmenu

menu "village-kernel"
	source ./village-kernel/Kconfig
endmenu

menu "village-demo"
	source ./village-demo/Kconfig
endmenu
```

## arm/Kconfig
```kconfig
choice
	prompt "ARM Series"
	depends on ARM
	default CORTEX_M

	config CORTEX_A
		bool "cortex-A"

	config CORTEX_R
		bool "cortex-R"

	config CORTEX_M
		bool "cortex-M"
endchoice

if CORTEX_M
	source ./vk.hardware/arm/cortex-m/Kconfig
endif
```

## arm/cortex-m/Kconfig
```kconfig
choice
	prompt "MCU Manufacturer"
	depends on CORTEX_M
	default ST

	config ST
		bool "ST"

	config GD
		bool "GD"
endchoice

if ST
source ./vk.hardware/arm/cortex-m/mcu/st/Kconfig
source ./vk.hardware/arm/cortex-m/hal/st/Kconfig
endif

source ./vk.hardware/arm/cortex-m/driver/Kconfig
```

## console/Kconfig
```kconfig
# console menu

menu "console"

config CONSOLE
	bool "Build console application"
	default n

if CONSOLE

config CMD_ABOUT
	bool "Add about cmd to console support list"
	default n

config CMD_FILESYS
	bool "Add file system cmd to console support list"
	default n

config CMD_HELP
	bool "Add help cmd to console support list"
	default n

config CMD_MEM
	bool "Add mem cmd to console support list"
	default n

config CMD_MOD
	select MODINSTALLER
	bool "Add insmod and rmmod cmd to console support list"
	default n

config CMD_RUN
	select EXECUTOR
	bool "Add run cmd to console support list"
	default n

endif

endmenu
```

## demo/Kconfig
```kconfig
# demo menu

menu "demo"

config DEMO
	bool "Build demo applications"
	default n

if DEMO

config APPLICATION1
	tristate "Add application1 to project"
	default y

config APPLICATION2
	tristate "Add application2 to project"
	default y

config APPLICATION3
	depends on GUI
	tristate "Add application3 to project"
	default n

config APPLICATION4
	tristate "Add application4 to project"
	default m

config APPLICATION5
	tristate "Add application5 to project"
	default m

config APPLICATION6
	tristate "Add application6 to project"
	default m

endif

endmenu
```

## village-boot/Kconfig
```kconfig
# This is using to configure bootloader

config BOOTLOADER
	bool "Enable bootloader function"
	default n

if BOOTLOADER

	comment "Select bootloader"

	choice
		prompt "boot mode"
		default LEGACY 

		config LEGACY
			bool "legacy"

		config UEFI
			bool "uefi"
	endchoice

	choice
		prompt "boot arch"
		default BOOTIA32

		config BOOTIA32
			bool "bootia32"

		config BOOTX64
			bool "bootx64"
	endchoice

endif
```

## village-demo/Kconfig
```kconfig
comment "This is using to configure vkdemo"

config VKDEMO
	bool "Enable building vkdemo"
	default y

if VKDEMO

	menu "libraries"
		comment "This is using to configure libraries"
	endmenu

	menu "modules"
		comment "This is using to configure modules"
		source ./village-demo/modules/demo/Kconfig
	endmenu

	menu "programs"
		comment "This is using to configure programs"
		source ./village-demo/programs/demo/Kconfig
	endmenu

	menu "services"
		comment "This is using to configure service"
		source ./village-demo/services/taichi/Kconfig
	endmenu

endif
```

## village-demo/modules/demo/Kconfig
```kconfig
# demo menu

menu "demo"

config DEMO_MOD
	tristate "Build demo module"
	default y

endmenu
```

## village-demo/programs/demo/Kconfig
```kconfig
# demo menu

menu "demo"

config DEMO_APP
	bool "Build demo application"
	default y

if DEMO_APP

config DEMO_POWER_UP
	bool "Running when power up"
	default y

endif

endmenu
```

## village-demo/services/taichi/Kconfig
```kconfig
# taichi menu

menu "taichi"

config TAICHI_SERVICE
	bool "Build taichi service"
	default y

endmenu
```

## village-gui/Kconfig
```kconfig
comment "This is using to configure gui"

# config GUI

config VKGUI
	bool "Enable village GUI support"
	default n

# config wedget

menu "Wedget"
	depends on VKGUI

config VKGUI_BUTTON
	bool "Enable button support"
	default y

config VKGUI_LABEL
	bool "Enable label support"
	default y

config VKGUI_LISTBOX
	bool "Enable list box support"
	default y

config VKGUI_MENU
	bool "Enable menu support"
	default y

config VKGUI_MSGBOX
	bool "Enable message box support"
	default y

config VKGUI_NAVBAR
	bool "Enable nav bar support"
	default y

config VKGUI_SCROLLBAR
	bool "Enable scroll bar support"
	default y

config VKGUI_TABBAR
	bool "Enable tab bar support"
	default y

config VKGUI_TABLE
	bool "Enable table support"
	default y

config VKGUI_TEXTBOX
	bool "Enable text box support"
	default y

config VKGUI_TOOLBAR
	bool "Enable tool bar support"
	default y

config VKGUI_WINDOW
	bool "Enable window support"
	default y

endmenu
```

## village-kernel/Kconfig
```kconfig
comment "This is using to configure kernel"

config KERNEL
	bool "Enable building kernel"
	default y

if KERNEL
	# config binutils menu

	menu "binutils"

		comment "This is using to configure binutils"

		config EXECUTOR
			select BINUTILS
			select FILESTREAM
			bool "Enable executor function"
			default n

		config BINEXECUTOR
			depends on EXECUTOR
			select BINLOADER
			bool "Enable *.bin file execute function"
			default n

		config ELFEXECUTOR
			depends on EXECUTOR
			select ELFLOADER
			bool "Enable *.elf file execute function"
			default n

		config HEXEXECUTOR
			depends on EXECUTOR
			select HEXLOADER
			bool "Enable *.hex file execute function"
			default n

		config BINUTILS
			select FILESTREAM
			bool "Enable binutils function"
			default n

		config BINLOADER
			depends on BINUTILS
			select FILESTREAM
			bool "Enable *.bin file loader function"
			default n

		config ELFLOADER
			depends on BINUTILS
			select FILESTREAM
			bool "Enable *.elf file loader function"
			default n

		config HEXLOADER
			depends on BINUTILS
			select FILESTREAM
			bool "Enable *.hex file loader function"
			default n

		config LIBTOOL
			depends on BINUTILS
			bool "Enable library tool function"
			default n

		config MODTOOL
			depends on BINUTILS
			bool "Enable module tool function"
			default n
	endmenu

	# config kernel menu

	menu "kernel"

	config KERNEL_RSVD_HEAP
		int "The size of kernel reserved heap"
		default 1024

	config KERNEL_RSVD_STACK
		int "The size of kernel reserved stack"
		default 1024

	config TASK_STACK
		int "The size of thread task stack"
		default 1024

	config MODULE
		bool "Enable loadable module support"
		select FATFS
		select ELFPARSER

	endmenu

	# config file system

	menu "filesys"

	config FATFS
		bool "Add fat file system in support list"
		default n

	endmenu

	menu "misc"

		menu "lock"

		comment "This is using to configure sync"

		config LOCK
			bool "Enable synchronizes function"
			default y

		config MUTEX
			depends on LOCK
			bool "Enable mutex lock support"
			default y

		config SPINLOCK
			depends on LOCK
			bool "Enable spin lock support"
			default y

		config SEMAPHORE
			depends on LOCK
			bool "Enable semaphore support"
			default y

		endmenu

		menu "model"

		comment "This is using to configure model"

		config MODEL
			bool "Enable design mode function"
			default y

		endmenu

		menu "parser"

		comment "This is using to configure parser"

		config PARSER
			bool "Enable parser support"
			default y

		config INIPARSER
			depends on PARSER
			select FILESTREAM
			bool "Enable ini file parser function"
			default n

		config RCPARSER
			depends on PARSER
			select FILESTREAM
			bool "Enable resource script parser function"
			default y

		config REGEX
			depends on PARSER
			bool "Enable regex function"
			default y

		endmenu

		menu "stream"

		comment "This is using to configure stream"

		config STREAM
			bool "Enable file utils support"
			default y

		config DEVSTREAM
			depends on STREAM
			bool "Enable devstream function"
			default y

		config DIRSTREAM
			depends on STREAM
			bool "Enable dirstream function"
			default y

		config FILESTREAM
			depends on STREAM
			bool "Enable filestream function"
			default y

		config FILESYSOPT
			depends on STREAM
			bool "Enable filesysopt function"
			default y

		endmenu

	endmenu

	# config protocol stack

	menu "protocol"

	config USB
		bool "Enable usb stack support"
		default n

	config USBD
		depends on USB
		bool "Enable usb device stack support"
		default n

	config USBH
		depends on USB
		bool "Enable usb host stack support"
		default n

	endmenu


	# terminal menu

	menu "terminal"

	config CMD_ABOUT
		bool "Add about cmd to terminal support list"
		default y

	config CMD_CAT
		bool "Add cat cmd to terminal support list"
		default y

	config CMD_DEBUG
		bool "Add debug cmd to terminal support list"
		default y

	config CMD_DEVICE
		bool "Add device cmd to terminal support list"
		default y

	config CMD_ECHO
		bool "Add echo cmd to terminal support list"
		default y

	config CMD_FILESYS
		bool "Add file system cmd to terminal support list"
		default y

	config CMD_HELP
		bool "Add help cmd to terminal support list"
		default y

	config CMD_KILL
		bool "Add kill cmd to terminal support list"
		default y

	config CMD_MEM
		bool "Add mem cmd to terminal support list"
		default y

	config CMD_MOD
		select MODINSTALLER
		bool "Add insmod and rmmod cmd to terminal support list"
		default y

	config CMD_NULL
		bool "Add null cmd to terminal support list"
		default y

	config CMD_POWER
		bool "Add power cmd to terminal support list"
		default y

	config CMD_PROCESS
		bool "Add process cmd to terminal support list"
		default y

	config CMD_RUN
		select EXECUTOR
		bool "Add run cmd to terminal support list"
		default y

	config CMD_TASKER
		bool "Add tasker cmd to terminal support list"
		default y

	endmenu

	# confg vklibs menu

	menu "vklibs"

		menu "libc"

		comment "This is using to configure libc"

		config VKLIBC
			bool "using vklibc"
			default y

		endmenu

		menu "libc++"

		comment "This is using to configure libc++"

		config VKLIBCPP
			bool "using vklibc++"
			default y

		endmenu

		menu "libm"

		comment "This is using to configure libm"

		config VKLIBM
			bool "using vklibm"
			default y

		endmenu

	endmenu

endif
```

## village-kernel/arch/x86/bios/Kconfig
```kconfig
comment "Configure Support Function"

# config cpu menu
menu "CPU Support Package"

comment "This is using to configure x86 arch"

config BOOTSECTION
	bool "The arch has boot setion"
	default y

endmenu

# config hal menu
menu "Hardware Abstraction Layer"

config HAL_PCI_CONTROLLER
	bool "Enable pci controller class"
	default y

config HAL_PS2_CONTROLLER
	bool "Enable ps2 controller class"
	default y

endmenu
```
