## village-kernel/drivers/Kconfig
```kconfig
menu "platform"

# IA32Legacy hal drv

if IA32LEGACY

config IA32LEGACY_DRV_PCI
	bool "Enable pci controller class"
	default y

config IA32LEGACY_DRV_PS2
	bool "Enable ps2 controller class"
	default y

endif

# STM32F4xx hal drv

if STM32F4xx

config STM32F4XX_DRV_HAL
	bool "Enable Hal drv class"
	default n

config STM32F4XX_DRV_GPIO
	bool "Enable GPIO drv class"
	default y

config STM32F4XX_DRV_NVIC
	bool "Enalbe NVIC drv class"
	default y

config STM32F4XX_DRV_USART
	select STM32F4XX_DRV_GPIO
	bool "Enable USART drv clas"
	default n

config STM32F4XX_DRV_SPI
	select STM32F4XX_DRV_GPIO
	bool "Enable SPI drv class"
	default n

config STM32F4XX_DRV_I2C
	select STM32F4XX_DRV_GPIO
	bool "Enable I2C drv class"
	default n

config STM32F4XX_DRV_DMA
	bool "Enable dma drv class"
	default n

config STM32F4XX_DRV_FSMC
	select STM32F4XX_DRV_GPIO
	bool "Enable FSMC drv class"
	default n

config STM32F4XX_DRV_EXTI
	select STM32F4XX_DRV_GPIO
	select STM32F4XX_DRV_NVIC
	bool "Enable EXTI drv class"
	default n

config STM32F4XX_DRV_USB
	select STM32F4XX_DRV_GPIO
	select STM32F4XX_DRV_NVIC
	bool "Enable USB drv class"
	default n

endif

# STM32H7xx hal drv

if STM32H7xx

config STM32H7XX_DRV_HAL
	bool "Enable Hal drv class"
	default n

config STM32H7XX_DRV_GPIO
	bool "Enable GPIO drv class"
	default y

config STM32H7XX_DRV_LTDC
	select STM32H7XX_DRV_GPIO
	bool "Enalbe LTDC drv class"
	default y

config STM32H7XX_DRV_NVIC
	bool "Enalbe NVIC drv class"
	default y

config STM32H7XX_DRV_USART
	select STM32H7XX_DRV_GPIO
	bool "Enable USART drv clas"
	default n

config STM32H7XX_DRV_SDIO
	select STM32H7XX_DRV_GPIO
	bool "Enable SDIO drv class"
	default n

config STM32H7XX_DRV_SPI
	select STM32H7XX_DRV_GPIO
	bool "Enable SPI drv class"
	default n

config STM32H7XX_DRV_I2C
	select STM32H7XX_DRV_GPIO
	bool "Enable I2C drv class"
	default n

config STM32H7XX_DRV_DMA
	bool "Enable DMA drv class"
	default n

config STM32H7XX_DRV_FSMC
	select STM32H7XX_DRV_GPIO
	bool "Enable FSMC drv class"
	default n

endif

endmenu

menu "peripheral"

menu "block"

config ATALBADISK
	tristate "Enable ata lba disk support"
	default n

config SDIOSDCARD
	tristate "Enable sdio sd card support"
	default n

config SPISDCARD
	tristate "Enable spi sd card support"
	default n

config SPIW25QXX
	tristate "Enable spi w25qxx flash support"
	default n

endmenu

menu "display"

config BOCHSVBE
	tristate "Enable Bochs VBE support"
	default n

config ILI9488
	tristate "Enable ILI9488 support"
	default n

endmenu

menu "dma"

config STM32DMA
	tristate "Enable stm32 dma fifo support"
	default n

endmenu

menu "keyboard"

config PS2KEYBOARD
	tristate "Enable ps2 key board input support"
	default n

endmenu

menu "mouse"

config PS2MOUSE
	tristate "Enable ps2 mouse input support"
	default n

endmenu

menu "serial"

config PIC32UART
	tristate "Enable pic32 uart support"
	default n

config STM32UART
	tristate "Enable stm32 uart support"
	default n

endmenu

menu "timer"

config PIT32TIMER
	tristate "Enable pit32 timer support"
	default n

endmenu

menu "usb"

config STM32USB
	tristate "Enable stm32 usb support"
	default n

endmenu

endmenu
```

## village-kernel/drivers/arm/cortex-m/Kconfig
```kconfig
menu "cortex-m Device Driver"

config DMAFIFO
	select DRV_DMA
	bool "Enable dma fifo support"
	default n

config ILI9488
	select DRV_FSMC
	select MANUFACTURER_HAL_DRIVER
	bool "Enable ILI9488 support"
	default n

config SDCARD
	select DRV_SPI
	bool "Enable SD card support"
	default n

config SPIFLASH
	select DRV_SPI
	bool "Enable SPI flash support"
	default n

config UARTSERIAL
	select DRV_USART
	bool "Enable UART serial support"
	default n

config USBSTORAGE
	depends on SDCARD || SPIFLASH
	select MANUFACTURER_HAL_DRIVER
	bool "Enable USB storage support"
	default n

endmenu
```

## village-kernel/vendor/Kconfig
```kconfig
comment "Select CPU Architecture"

choice
	prompt "Architecture"
	default ARM

	config ARM
		bool "arm"

	config X86
		bool "x86"
		select BOOTSECTION
endchoice

comment "Configure Support Function"

## ARM
if ARM

choice
	prompt "ARM Series"
	depends on ARM
	default CORTEX_M

	config CORTEX_A
		bool "cortex-A"

	config CORTEX_R
		bool "cortex-R"

	config CORTEX_M
		bool "cortex-M"
endchoice

if CORTEX_M
	source ./village-kernel/vendor/arm/cortex-m/Kconfig
endif

endif

## X86
if X86

choice
	prompt "Boot fireware"
	depends on X86
	default BIOS

	config BIOS
		bool "bios"

endchoice

if BIOS
	source ./village-kernel/vendor/x86/bios/Kconfig
endif

endif
```

## village-kernel/vendor/arm/cortex-m/Kconfig
```kconfig
choice
	prompt "MCU Manufacturer"
	depends on CORTEX_M
	default ST

	config ST
		bool "ST"

	config GD
		bool "GD"
endchoice

if ST
source ./village-kernel/vendor/arm/cortex-m/mcu/st/Kconfig
source ./village-kernel/vendor/arm/cortex-m/hal/st/Kconfig
endif

source ./village-kernel/vendor/arm/cortex-m/driver/Kconfig
```

## village-kernel/vendor/arm/cortex-m/hal/st/Kconfig
```kconfig
menu "Hardware Abstraction Layer"

if STM32F4xx
	source ./village-kernel/vendor/arm/cortex-m/hal/st/stm32f4xx/Kconfig
endif

if STM32H7xx
	source ./village-kernel/vendor/arm/cortex-m/hal/st/stm32h7xx/Kconfig
endif

endmenu
```
